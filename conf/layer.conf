## conf/layer.conf
```bitbake
# We have a conf and classes directory, add to BBPATH
BBPATH .= ":${LAYERDIR}"

# We have recipes-* directories, add to BBFILES
BBFILES += "${LAYERDIR}/recipes-*/*/*.bb \
            ${LAYERDIR}/recipes-*/*/*.bbappend"

#BBMASK += "${LAYERDIR}/recipes-connectivity/dnsmasq/"
BBMASK += "${LAYERDIR}/recipes-core/busybox-files/"

BBFILE_COLLECTIONS += "custom"
BBFILE_PATTERN_custom = "^${LAYERDIR}/"
BBFILE_PRIORITY_custom = "7"

LAYERVERSION_custom = "3"
LAYERSERIES_COMPAT_custom = "thud"
```

## conf/machine/beaglebone.conf
```bitbake
#@TYPE: Machine
#@NAME: BeagleBone machine
#@DESCRIPTION: Machine configuration for the http://beagleboard.org/bone board

require conf/machine/include/ti33x.inc

KERNEL_DEVICETREE = "am335x-bone.dtb am335x-boneblue.dtb \
                    am335x-boneblack.dtb am335x-boneblack-wireless.dtb \
                    am335x-bonegreen.dtb am335x-bonegreen-wireless.dtb"

# Only has DVI connector for external screen
MACHINE_GUI_CLASS = "bigscreen"

SERIAL_CONSOLES = "115200;ttyS0"

WKS_FILE = "sdimage-bootpart.wks"

do_image_wic[depends] += "mtools-native:do_populate_sysroot dosfstools-native:do_populate_sysroot"
IMAGE_BOOT_FILES ?= "u-boot.${UBOOT_SUFFIX} ${SPL_BINARY}"

IMAGE_FSTYPES += "tar.xz wic.xz"

GCCVERSION = "7.%"

#LICENSE_FLAGS_WHITELIST = "Firmware_rtlwifi"

MACHINE_ESSENTIAL_EXTRA_RDEPENDS += "rtl8188eu"

WLAN0_MODE = "static"


IMAGE_INSTALL_append += " kernel-image-zimage kernel-modules"
IMAGE_INSTALL_append += " kernel-image-vmlinuz"
IMAGE_INSTALL_append += " dts-rebuild"
IMAGE_INSTALL_append += " bbb-overlays"
IMAGE_INSTALL_append += " bbb-robo"
IMAGE_INSTALL_append += " bbb-boot-uenv"
IMAGE_INSTALL_append += " linux-firmware-rtl8188eu"
IMAGE_INSTALL_append += " dnsmasq"
IMAGE_INSTALL_append += "${@bb.utils.contains('WLAN0_MODE', 'static', ' wpa-supplicant', '', d)}"
IMAGE_INSTALL_append += "${@bb.utils.contains('WLAN0_MODE', 'dynamic', ' wpa-supplicant', '', d)}"
IMAGE_INSTALL_append += "${@bb.utils.contains('WLAN0_MODE', 'ap', ' hostapd', '', d)}"
IMAGE_INSTALL_append += " openssh openssh-sftp-server openssl iw mosquitto"
IMAGE_INSTALL_append += " boost usbutils nano libprussdrv rootfs-files"
IMAGE_INSTALL_append += " json-c"
IMAGE_INSTALL_append += " amx3-cm3"
IMAGE_INSTALL_append += " rng-tools"
IMAGE_INSTALL_append += " lttng-tools lttng-modules lttng-ust"

#OE_TERMINAL_CUSTOMCMD = "xterm"

OE_TERMINAL = "xterm"

KERNEL_MODULE_AUTOLOAD += "configfs libcomposite u_ether usb_f_rndis g_ether uio_pruss spidev"

# Refine the list of device targets for ti-pdk class recipes
TI_PDK_LIMIT_BOARDS = "bbbAM335x"

# Default providers, may need to override for specific machines
PREFERRED_PROVIDER_virtual/kernel = "linux-custom-rt"
PREFERRED_VERSION_linux-custom-rt = "4.9%"

#PREFERRED_PROVIDER_virtual/kernel = "linux-custom-rt"
#PREFERRED_VERSION_linux-custom = "4.14%"

PREFERRED_PROVIDER_virtual/bootloader = "u-boot-custom"
PREFERRED_VERSION_uboot-boot-custom = "2018.09%"
PREFERRED_PROVIDER_u-boot = "u-boot-custom"

PREFERRED_VERSION_rtl8188eu = "1.0.2"

#PREFERRED_VERSION_dts-rebuild = "4.14%"
#PREFERRED_VERSION_bbb-boot-uenv = "4.14%"

PREFERRED_VERSION_dts-rebuild = "4.9%"
PREFERRED_VERSION_bbb-boot-uenv = "4.9%"
```
